## configs/beaglebone_defconfig
```kconfig
# Architecture
BR2_i386=y
#BR2_arm=y  # eski satır yoruma alındı
#BR2_cortex_a8=y  # eski satır yoruma alındı
#BR2_ARM_FPU_VFPV3=y  # eski satır yoruma alındı

# Patches
BR2_GLOBAL_PATCH_DIR="board/beaglebone/patches"

# Linux headers same as kernel, a 5.10 series
BR2_PACKAGE_HOST_LINUX_HEADERS_CUSTOM_5_10=y

# System
BR2_ROOTFS_DEVICE_CREATION_DYNAMIC_MDEV=y

# Image
BR2_ROOTFS_POST_BUILD_SCRIPT="board/beaglebone/post-build.sh"
BR2_ROOTFS_POST_IMAGE_SCRIPT="support/scripts/genimage.sh"
BR2_ROOTFS_POST_SCRIPT_ARGS="-c board/beaglebone/genimage.cfg"

# Kernel
BR2_LINUX_KERNEL=y
BR2_LINUX_KERNEL_CUSTOM_TARBALL=y
BR2_LINUX_KERNEL_CUSTOM_TARBALL_LOCATION="$(call github,beagleboard,linux,5.10.30-ti-r3)/linux-5.10.30-ti-r3.tar.gz"
BR2_LINUX_KERNEL_DEFCONFIG="i386_defconfig"  # arm den x86 defconfig değiştirildi
BR2_LINUX_KERNEL_DTS_SUPPORT=n  # x86 için dts kapalı
BR2_LINUX_KERNEL_NEEDS_HOST_OPENSSL=y

# Filesystem
BR2_TARGET_ROOTFS_EXT2=y
BR2_TARGET_ROOTFS_EXT2_4=y
BR2_TARGET_GENERIC_HOSTNAME="X86BUILD"

# Bootloader
# ARM için U-Boot iptal edildi
# BR2_TARGET_UBOOT=y
# BR2_TARGET_UBOOT_BUILD_SYSTEM_KCONFIG=y
# BR2_TARGET_UBOOT_CUSTOM_VERSION=y
# BR2_TARGET_UBOOT_CUSTOM_VERSION_VALUE="2021.04"
# BR2_TARGET_UBOOT_BOARD_DEFCONFIG="am335x_evm"
# BR2_TARGET_UBOOT_NEEDS_DTC=y
# BR2_TARGET_UBOOT_FORMAT_IMG=y
# BR2_TARGET_UBOOT_SPL=y
# BR2_TARGET_UBOOT_SPL_NAME="MLO"

# x86 için GRUB bootloader eklenmeli (isteğe bağlı)
BR2_TARGET_GRUB2=y

# Required tools to create the SD image
BR2_PACKAGE_HOST_DOSFSTOOLS=y
BR2_PACKAGE_HOST_GENIMAGE=y
BR2_PACKAGE_HOST_MTOOLS=y

# Supporting host tools to build FIT image
BR2_PACKAGE_HOST_UBOOT_TOOLS=y
BR2_PACKAGE_HOST_UBOOT_TOOLS_FIT_SUPPORT=y

# Ek paketler
BR2_PACKAGE_BASH=y
BR2_PACKAGE_WGET=y
BR2_PACKAGE_CURL=y
BR2_PACKAGE_PYTHON3=y
```
